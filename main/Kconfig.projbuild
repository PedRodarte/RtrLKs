## main/Kconfig.projbuild
```kconfig
menu "FindLK"

    menu "Tela (ST7789 172x320)"

        config FINDLK_LCD_SPI_MHZ
            int "Clock SPI do LCD (MHz)"
            range 1 80
            default 40
            help
                Reduza (ex. 20) se aparecerem artefatos na imagem.

        config FINDLK_LCD_X_GAP
            int "Deslocamento X da área visível"
            default 34

        config FINDLK_LCD_Y_GAP
            int "Deslocamento Y da área visível"
            default 0

        config FINDLK_LCD_INVERT_COLORS
            bool "Inverter cores (necessário na maioria dos painéis IPS ST7789)"
            default y

        config FINDLK_LCD_BGR
            bool "Ordem de cores BGR (troque se vermelho e azul aparecerem trocados)"
            default n

    endmenu

    menu "LED (WS2812)"

        config FINDLK_LED_GRB
            bool "Ordem de cores GRB (troque se vermelho e verde aparecerem trocados)"
            default n
            help
                O LED desta placa usa ordem RGB. A maioria dos WS2812 avulsos usa GRB.

        config FINDLK_LED_NORMAL_BRIGHTNESS
            int "Brilho máximo da respiração verde no modo normal (0 = apagado)"
            range 0 255
            default 16

        config FINDLK_LED_BREATH_PERIOD_MS
            int "Duração de uma respiração no modo normal (ms)"
            range 1000 10000
            default 4000

        config FINDLK_LED_ACTIVE_BRIGHTNESS
            int "Brilho do pareamento e das cores de proximidade (chegando)"
            range 1 255
            default 64

        config FINDLK_LED_ALERT_BRIGHTNESS
            int "Brilho da sirene de PERDIDO"
            range 1 255
            default 160

        config FINDLK_LED_SIREN_HALF_PERIOD_MS
            int "Tempo de cada cor da sirene vermelho/azul (ms)"
            range 50 1000
            default 200

    endmenu

    config FINDLK_HW_PROBE
        bool "Diagnóstico ao ligar: procurar touch e IMU (versão Touch da placa)"
        default n
        help
            Varre o I2C dos GPIO18/19 procurando o touch AXS5106L e a IMU QMI8658
            e mostra o resultado na tela por 10 s.

    config FINDLK_DISPLAY_TEST
        bool "Modo de teste da tela (percorre todas as telas em ciclo, sem Bluetooth)"
        default n
        help
            Mostra padrão de teste, tela de PERDIDO, tela "chegando" e passkey em ciclo,
            com as cores do LED. Com esta opção ligada, o Bluetooth não é iniciado.

    config FINDLK_QR_URL
        string "URL padrão da página do QR"
        default "https://pedrodarte.github.io/RtrLKs/"
        help
            Sem "?" no fim: a tag acrescenta t= (telefone) e d= (nome da tag).
            O app do celular pode trocar a URL e o telefone pela característica
            Configuração, sem regravar o firmware.

    menu "Bluetooth"

        config FINDLK_BLE_NAME
            string "Nome anunciado"
            default "FindLK01"
            help
                Use o número da versão no nome (FindLK01, FindLK02...) para saber
                qual firmware está em cada tag.

        config FINDLK_PAIRING_WINDOW_S
            int "Tempo da janela de pareamento após segurar o BOOT (s)"
            range 10 600
            default 60
            help
                Com nenhum celular pareado, o primeiro pareia sem o botão. Depois disso,
                novos pareamentos só são aceitos dentro desta janela.

        config FINDLK_TEST_LOG_PASSKEY
            bool "TESTE: também imprimir o passkey no log serial"
            default n
            help
                Só para testes automatizados pelo PC (tools/test_ble_pc.py). Deixe
                desligado no uso real: o passkey deve aparecer apenas na tela.

        config FINDLK_RSSI_APPROACHING
            int "RSSI mínimo para \"aproximando\" (dBm)"
            range -120 0
            default -85

        config FINDLK_RSSI_NEAR
            int "RSSI mínimo para \"próximo\" (dBm)"
            range -120 0
            default -75

        config FINDLK_RSSI_VERY_NEAR
            int "RSSI mínimo para \"muito perto\" (dBm)"
            range -120 0
            default -65

        config FINDLK_RSSI_MAX
            int "RSSI mínimo para \"sinal máximo\" (dBm)"
            range -120 0
            default -55

    endmenu

    menu "Wi-Fi de casa (desarme automático)"

        config FINDLK_HOME_SSIDS
            string "Redes de casa (SSIDs separados por ;)"
            default ""
            help
                Ex.: "MinhaCasa;MinhaCasa 5G" (até 4). Ao ver uma delas, a tag desarma e
                ignora heartbeats até sair de casa. Vazio = recurso desligado. A tag só
                escaneia: não se conecta nem precisa da senha.

        config FINDLK_HOME_SCAN_PERIOD_S
            int "Intervalo entre buscas (s)"
            range 10 600
            default 30

        config FINDLK_HOME_MISSES_TO_LEAVE
            int "Buscas seguidas sem a rede para considerar que saiu de casa"
            range 1 10
            default 2

    endmenu

    config FINDLK_LOST_TIMEOUT_S
        int "Segundos sem heartbeat até entrar em PERDIDO"
        range 5 600
        default 20

endmenu
```

## sdkconfig.defaults
```kconfig
CONFIG_IDF_TARGET="esp32c6"
CONFIG_ESPTOOLPY_FLASHSIZE_4MB=y
CONFIG_PARTITION_TABLE_CUSTOM=y
CONFIG_PARTITION_TABLE_CUSTOM_FILENAME="partitions.csv"

# LVGL
CONFIG_LV_COLOR_DEPTH_16=y
CONFIG_LV_MEM_SIZE=49152
CONFIG_LV_USE_QRCODE=y

# Bluetooth LE (NimBLE, só periférico)
CONFIG_BT_ENABLED=y
CONFIG_BT_NIMBLE_ENABLED=y
CONFIG_BT_NIMBLE_ROLE_CENTRAL=n
CONFIG_BT_NIMBLE_ROLE_OBSERVER=n
CONFIG_BT_NIMBLE_MAX_CONNECTIONS=3
CONFIG_BT_NIMBLE_MAX_BONDS=8
CONFIG_BT_NIMBLE_NVS_PERSIST=y
```
